## u-boot-2014.10/board/mini2440/Kconfig
```kconfig
if TARGET_MINI2440

config SYS_CPU
	default "arm920t"

config SYS_BOARD
	default "mini2440"
	
config SYS_SOC
	default "s3c24x0"
 
config SYS_CONFIG_NAME
	default "mini2440"

endif
```
